/**
  ******************************************************************************
  * @file    LCD.c
  * @brief   ILI9341 SPI DRIVERS FOR TM4C
  * @author  Lihaozhe from ICEC-SAST of HEU
  * @version V2.0
  * @date    2015-7-20
  ******************************************************************************
  */
	
#include "ili9341_driver.h"


#if 0

const char image[]={ /* 0X00,0X10,0X28,0X00,0X28,0X00,0X01,0X1B,*/
0XFF,0XFF,0XFF,0XFF,0XFF,0XFF,0XFF,0XFF,0XFF,0XFF,0XFF,0XFF,0XFF,0XFF,0XFF,0XFF,
0XFF,0XFF,0XFF,0XFF,0XFF,0XFF,0XFF,0XFF,0XFF,0XFF,0XFF,0XFF,0XBE,0XF7,0X7D,0XEF,
0XBA,0XD6,0XB6,0XB5,0XF3,0X9C,0XB2,0X94,0XB3,0X9C,0XB2,0X94,0X34,0XA5,0XF7,0XBD,
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0XB7,0XAD,0X79,0XC6,0X3C,0XE7,0XBE,0XF7,0XFF,0XFF,0XFF,0XFF,0XFF,0XFF,0XFF,0XFF,
};

#endif


unsigned char test[]={
0x00,0x00,0x00,0x00,0x00,0x00,0x00,0x00,0x00,0x00,0x00,0x00,0x00,0x00,0x00,0x06,0x00,0x00,0x00,0x0C,0x00,0x00,0x03,0x0C,0xC0,0xE8,0x07,0x0C,0xC0,0x19,0x06,0x0C,
0x80,0x09,0x06,0x0C,0x00,0x48,0x26,0x0C,0x00,0xC8,0x66,0x0C,0x00,0xC8,0x66,0x0C,0x18,0xC8,0x46,0x0C,0x30,0x48,0x46,0x0C,0x30,0x49,0x46,0x0C,0x80,0x48,0x46,0x0C,
0x80,0x48,0x46,0x0C,0x40,0x4C,0x66,0x0C,0x40,0x6C,0x66,0x0C,0x60,0x68,0x42,0x0C,0x30,0xE0,0x02,0x0C,0x38,0x20,0x03,0x0C,0x38,0x30,0x07,0x0C,0x18,0x18,0x0E,0x0C,
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0xC0,0xF3,0x80,0x21,0xE0,0x38,0x00,0x33,0x40,0x00,0x00,0x3E,0x00,0x00,0x00,0x3C,0x00,0x00,0x00,0x38,0x00,0x00,0x00,0x30,0x00,0x00,0x00,0x00,0x00,0x00,0x00,0x00,/*"试",1*/
};

const unsigned char asc2_1608[1520]={///1608字符库
	
0x00,0x00,0x00,0x00,0x00,0x00,0x00,0x00,0x00,0x00,0x00,0x00,0x00,0x00,0x00,0x00,
0x00,0x00,0x00,0x08,0x08,0x08,0x08,0x08,0x08,0x08,0x00,0x00,0x18,0x18,0x00,0x00,
0x00,0x48,0x6C,0x24,0x12,0x00,0x00,0x00,0x00,0x00,0x00,0x00,0x00,0x00,0x00,0x00,
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0x0C,0x32,0xC2,0x00,0x00,0x00,0x00,0x00,0x00,0x00,0x00,0x00,0x00,0x00,0x00,0x00,
}; 
uint16_t BACK_COLOR, POINT_COLOR;   //背景色，画笔色	  

#define SPI_WRITEBy_posTE(byte)                     \
do {                                                 \
    if((byte) & 0x80) ILI9341_SDI_H; else ILI9341_SDI_L; \
    ILI9341_SCK_L;                                   \
    ILI9341_SCK_H;                                   \
    if((byte) & 0x40) ILI9341_SDI_H; else ILI9341_SDI_L; \
    ILI9341_SCK_L;                                   \
    ILI9341_SCK_H;                                   \
    if((byte) & 0x20) ILI9341_SDI_H; else ILI9341_SDI_L; \
    ILI9341_SCK_L;                                   \
    ILI9341_SCK_H;                                   \
    if((byte) & 0x10) ILI9341_SDI_H; else ILI9341_SDI_L; \
    ILI9341_SCK_L;                                   \
    ILI9341_SCK_H;                                   \
    if((byte) & 0x08) ILI9341_SDI_H; else ILI9341_SDI_L; \
    ILI9341_SCK_L;                                   \
    ILI9341_SCK_H;                                   \
    if((byte) & 0x04) ILI9341_SDI_H; else ILI9341_SDI_L; \
    ILI9341_SCK_L;                                   \
    ILI9341_SCK_H;                                   \
    if((byte) & 0x02) ILI9341_SDI_H; else ILI9341_SDI_L; \
    ILI9341_SCK_L;                                   \
    ILI9341_SCK_H;                                   \
    if((byte) & 0x01) ILI9341_SDI_H; else ILI9341_SDI_L; \
    ILI9341_SCK_L;                                   \
    ILI9341_SCK_H;                                   \
} while(0)



static void delayms(unsigned int nms)///延时函数
{
  HAL_Delay(nms);
}

void ILI9341_wr_data8(char da) //发送数据-8位参数///一次只能传送8位数据
{
    ILI9341_CS_L;
    ILI9341_RS_H;
	SPI_WRITEBy_posTE(da);
    ILI9341_CS_H;
}  

 void ILI9341_wr_data(int da)
{
    ILI9341_CS_L;
    ILI9341_RS_H;
	SPI_WRITEBy_posTE(da>>8);
	SPI_WRITEBy_posTE(da & 0XFF);
    ILI9341_CS_H;
}	  

void ILI9341_wr_reg(char da)	 
{
    ILI9341_CS_L;
    ILI9341_RS_L;
	SPI_WRITEBy_posTE(da);
    ILI9341_CS_H;
}
 void ILI9341_wr_reg_data(int reg,int da)
{
    ILI9341_CS_L;
    ILI9341_wr_reg(reg);
    ILI9341_wr_data(da);
    ILI9341_CS_H;
} 

void ILI9341_address_set(unsigned int x1,unsigned int y1,unsigned int x2,unsigned int y2)//2016.14.14 地址设置函数为非人为设定函数
{  
   ILI9341_wr_reg(0x2a);///设置列地址
   ILI9341_wr_data8(x1>>8);
   ILI9341_wr_data8(x1);
   ILI9341_wr_data8(x2>>8);
   ILI9341_wr_data8(x2);
  
   ILI9341_wr_reg(0x2b);///设置页地址
   ILI9341_wr_data8(y1>>8);
   ILI9341_wr_data8(y1);
   ILI9341_wr_data8(y2>>8);
   ILI9341_wr_data8(y2);

   ILI9341_wr_reg(0x2c);///储存器写操作
}

void ILI9341_init(uint16_t Color)///初始化操作
{
	ILI9341_RST_L;///RST引脚写低电平
	delayms(100);
	ILI9341_RST_H;
	delayms(50);///复位后延时用于稳定状态

	ILI9341_LED_H;

	ILI9341_wr_reg(0xCB);  ///功耗控制A （5个参数）
  ILI9341_wr_data8(0x39); 
  ILI9341_wr_data8(0x2C); 
  ILI9341_wr_data8(0x00); ///前三个参数为默认参数
  ILI9341_wr_data8(0x34); ///内核电压控制 （1.6V）
  ILI9341_wr_data8(0x02); ///DDVDH控制 （5.6V）

  ILI9341_wr_reg(0xCF);  ///功耗控制B  （3个参数）
  ILI9341_wr_data8(0x00); ///默认
  ILI9341_wr_data8(0XC1); ///
  ILI9341_wr_data8(0X30); ///
 
  ILI9341_wr_reg(0xE8);  ///驱动时序控制A （3个参数）
  ILI9341_wr_data8(0x85); 
  ILI9341_wr_data8(0x00); 
  ILI9341_wr_data8(0x78); 
 
  ILI9341_wr_reg(0xEA);  ///驱动时序控制B （2个参数）
  ILI9341_wr_data8(0x00); 
  ILI9341_wr_data8(0x00); 
 
  ILI9341_wr_reg(0xED);  ///电源序列控制 （4个参数）
	ILI9341_wr_data8(0x64); 
  ILI9341_wr_data8(0x03); 
  ILI9341_wr_data8(0X12); 
  ILI9341_wr_data8(0X81); 

  ILI9341_wr_reg(0xF7);  ///汞比控制
	ILI9341_wr_data8(0x20); 
  
  ILI9341_wr_reg(0xC0);    //Power control ///功耗控制
	ILI9341_wr_data8(0x23);   //VRH[5:0] ///设置GVDD电平，设置为4.6V
 
	ILI9341_wr_reg(0xC1);    //Power control ///设置用于升压电路的因子
	ILI9341_wr_data8(0x10);   //SAP[2:0];BT[3:0] 
 
	ILI9341_wr_reg(0xC5);    //VCM control ///设置VCOM电压
	ILI9341_wr_data8(0x3e); //对比度调节
	ILI9341_wr_data8(0x28); ///3.7V
 
	ILI9341_wr_reg(0xC7);    //VCM control2 
	ILI9341_wr_data8(0x86);  //--
 
	ILI9341_wr_reg(0x36);    // Memory Access Control 
#ifdef USE_HORIZONTAL
    ILI9341_wr_data8(0xE8); //C8	   //48 68竖屏//28 E8 横屏
#else
		ILI9341_wr_data8(0x48); 
#endif

	ILI9341_wr_reg(0x3A);    ///像素格式设置
	ILI9341_wr_data8(0x55); 

	ILI9341_wr_reg(0xB1);    ///帧速率控制 (两个参数)
	ILI9341_wr_data8(0x00);  ///内部时钟分频
	ILI9341_wr_data8(0x18);  ///设置用于一行的时间 (31clocks)
 
	ILI9341_wr_reg(0xB6);    // Display Function Control ///显示功能控制 （4个参数）
	ILI9341_wr_data8(0x08);  ///
	ILI9341_wr_data8(0x82);
	ILI9341_wr_data8(0x27);  
 
	ILI9341_wr_reg(0xF2);    // 3Gamma Function Disable 
	ILI9341_wr_data8(0x00); 
 
	ILI9341_wr_reg(0x26);    //Gamma curve selected 
	ILI9341_wr_data8(0x01); 
 
	ILI9341_wr_reg(0xE0);    //Set Gamma 
	ILI9341_wr_data8(0x0F); 
	ILI9341_wr_data8(0x31); 
	ILI9341_wr_data8(0x2B); 
	ILI9341_wr_data8(0x0C); 
	ILI9341_wr_data8(0x0E); 
	ILI9341_wr_data8(0x08); 
	ILI9341_wr_data8(0x4E); 
	ILI9341_wr_data8(0xF1); 
	ILI9341_wr_data8(0x37); 
	ILI9341_wr_data8(0x07); 
	ILI9341_wr_data8(0x10); 
	ILI9341_wr_data8(0x03); 
	ILI9341_wr_data8(0x0E); 
	ILI9341_wr_data8(0x09); 
	ILI9341_wr_data8(0x00); 

	ILI9341_wr_reg(0XE1);    //Set Gamma 
	ILI9341_wr_data8(0x00); 
	ILI9341_wr_data8(0x0E); 
	ILI9341_wr_data8(0x14); 
	ILI9341_wr_data8(0x03); 
	ILI9341_wr_data8(0x11); 
	ILI9341_wr_data8(0x07); 
	ILI9341_wr_data8(0x31); 
	ILI9341_wr_data8(0xC1); 
	ILI9341_wr_data8(0x48); 
	ILI9341_wr_data8(0x08); 
	ILI9341_wr_data8(0x0F); 
	ILI9341_wr_data8(0x0C); 
	ILI9341_wr_data8(0x31); 
	ILI9341_wr_data8(0x36); 
	ILI9341_wr_data8(0x0F); 

	ILI9341_wr_reg(0x11);    //Exit Sleep ///退出睡眠模式，需要延时120ms
	delayms(200);  // 手册上面写的是120ms，在这里延时长一点
				
	ILI9341_wr_reg(0x29);    //Display on ///开显示
	ILI9341_wr_reg(0x2c);    ///储存器写
	
	BACK_COLOR=Color;
	ILI9341_clear(Color);
	BACK_COLOR=Color;
}


/*---------------------------------------------------------------
函数功能：清屏
Color: 要清屏的填充色
---------------------------------------------------------------*/
void ILI9341_clear(uint16_t Color)///从0,0 开始不断地依次给每位写颜色
{
	uint8_t VH,VL;
	uint16_t i,j;
	VH=Color>>8;
	VL=Color;	
	
	ILI9341_address_set(0,0,X_MAX_PIXEL-1,Y_MAX_PIXEL-1);
    for(i=0;i<X_MAX_PIXEL;i++)
	 {
	   for (j=0;j<Y_MAX_PIXEL;j++)
	   {
        ILI9341_wr_data8(VH);
				ILI9341_wr_data8(VL);	

	     }
	  }
}
/*函数功能：在指定区域内填充指定颜色
区域大小:
	(xend-xsta)*(yend-ysta)
color: 使用的颜色
---------------------------------------------------------------*/
void ILI9341_fill(uint16_t xsta,uint16_t ysta,uint16_t xend,uint16_t yend,uint16_t color)
{          
	uint16_t i,j; 
	
	ILI9341_address_set(xsta,ysta,xend,yend);      //设置光标位置 
	
	for(i=ysta;i<=yend;i++)
	{													   	 	
		for(j=xsta;j<=xend;j++)ILI9341_wr_data(color);//设置光标位置 	    
	}
}  
/*---------------------------------------------------------------
函数功能：画点
POINT_COLOR: 此点的颜色
---------------------------------------------------------------*/
void ILI9341_draw_point(uint16_t x,uint16_t y,uint16_t COLOR)
{
	ILI9341_address_set(x,y,x,y);//设置光标位置 
	ILI9341_wr_data(COLOR); 	    
} 	 
/*---------------------------------------------------------------
函数功能：画一个大点
POINT_COLOR: 此点的颜色
---------------------------------------------------------------*/
void ILI9341_draw_point_big(uint16_t x,uint16_t y,uint16_t COLOR)
{
	ILI9341_fill(x-1,y-1,x+1,y+1,COLOR);
} 

void ILI9341_draw_char(uint16_t x,uint16_t y,char num,uint8_t mode,uint16_t COLOR)//x为行 隔8 y为列 隔16   字符范围32到127  数字范围48到58 字母65到90 97到122
{
  uint8_t temp;
  uint8_t pos,t;
	uint16_t x0=x;
	uint16_t colortemp=COLOR;      
	
  if(x>X_MAX_PIXEL-16||y>Y_MAX_PIXEL-16)return;	    ///如果不足以写，则结束函数
	//设置窗口		   
	num=num-' ';//得到偏移后的值
	ILI9341_address_set(x,y,x+8-1,y+16-1);      //设置光标位置 
	///非叠加方式与叠加方式的区别
	if(!mode) //非叠加方式
	{
		for(pos=0;pos<16;pos++)
		{ 
			temp=asc2_1608[(uint16_t)num*16+pos];		 //调用1608字体
			for(t=0;t<8;t++)
		    {                 
		      if(temp&0x01){POINT_COLOR=colortemp;}
					else POINT_COLOR=BACK_COLOR;
					ILI9341_wr_data(POINT_COLOR);	
					temp>>=1; 
					x++;
		    }
			x=x0;
			y++;
		}	
	}
	else//叠加方式
	{
		for(pos=0;pos<16;pos++)
		{
		  temp=asc2_1608[(uint16_t)num*16+pos];		 //调用1608字体
			for(t=0;t<8;t++)
		  {   
		     if(temp&0x01)ILI9341_draw_point(x+t,y+pos,POINT_COLOR);//画一个点     
		     temp>>=1; 
		  }
		}
	}
POINT_COLOR=colortemp;	    	   	 	  
}   

/*---------------------------------------------------------------
函数功能：画线
x1,y1: 起点坐标
x2,y2: 终点坐标  
---------------------------------------------------------------*/
void ILI9341_draw_line(uint16_t x1, uint16_t y1, uint16_t x2, uint16_t y2,uint16_t COLOR)
{
	uint16_t t; 
	int xerr=0,yerr=0,delta_x,delta_y,distance; 
	int incx,incy,uRow,uCol; 
	delta_x=x2-x1; //计算坐标增量 
	delta_y=y2-y1; 
	uRow=x1; 
	uCol=y1; 
	if(delta_x>0)incx=1; //设置单步方向 
	else if(delta_x==0)incx=0;//垂直线 
	else {incx=-1;delta_x=-delta_x;} 
	
	if(delta_y>0)incy=1; 
	else if(delta_y==0)incy=0;//水平线 
	else{incy=-1;delta_y=-delta_y;} 
	
	if(delta_x>delta_y)distance=delta_x; //选取基本增量坐标轴 
	else distance=delta_y;
	
	for(t=0;t<=distance+1;t++)//画线输出 
	{
		ILI9341_draw_point(uRow,uCol,COLOR);//画点 
		xerr+=delta_x ; 
		yerr+=delta_y ;
		if(xerr>distance) 
		{ 
			xerr-=distance; 
			uRow+=incx; 
		} 
		if(yerr>distance) 
		{ 
			yerr-=distance; 
			uCol+=incy; 
		} 
	} 
}    
/*---------------------------------------------------------------
函数功能：画矩形
x1,y1: 起始点 (x范围0到500)
x2.y2: 终止点 (y范围0到500)
---------------------------------------------------------------*/
void ILI9341_draw_rectangle(uint16_t x1, uint16_t y1, uint16_t x2, uint16_t y2,uint16_t COLOR)
{
	ILI9341_draw_line(x1,y1,x2,y1,COLOR);
	ILI9341_draw_line(x1,y1,x1,y2,COLOR);
	ILI9341_draw_line(x1,y2,x2,y2,COLOR);
	ILI9341_draw_line(x2,y1,x2,y2,COLOR);
}
/*---------------------------------------------------------------
函数功能：显示字符串 
x,y: 起点坐标  
*p: 字符串起始地址
COLOR: 颜色
---------------------------------------------------------------*/
void ILI9341_draw_string(uint16_t x,uint16_t y,const char *p,uint16_t COLOR)
{         
    while(*p!='\0')
    {       
        if(x>X_MAX_PIXEL-16){x=0;y+=16;}
        if(y>Y_MAX_PIXEL-16){y=x=0;}
        ILI9341_draw_char(x,y,*p,0, COLOR);
        x+=8;
        p++;
    }  
}



